/*
 * SC-OBC V1 QEMU hardware description
 *
 * This file has no boot flash part. The board-scobc-v1-*-ps-virt.dts files
 * define SCOBC_BOOT_MEMORY for each board and include it. Rev. A has the
 * same parts in both grades, so board-scobc-v1-reva-ps-virt.dts also
 * describes the Rev. A developer grade. Rev. B has one per grade.
 */

#ifndef SCOBC_BOOT_MEMORY
#error "SCOBC_BOOT_MEMORY is not defined, build a board-scobc-v1-*-ps-virt.dts"
#endif

#include "board-versal-xcve2302-ps-virt.dts"

/ {
    model = "Space Cubics SC-OBC Module V1";
    compatible = "sc,scobc-v1", "xlnx,versal-virt";
};

/*
 * The safety processor sits on SPI1 instead of the flash. It is only
 * connected in board-scobc-v1-ps-sp-virt.dtsi.
 */
&spi1 {
	/delete-node/ spi1_flash0@0;
};

/* SPI0 is unused */
&spi0 {
    /delete-node/ spi0_flash0@0;
};

/*
 * The two boot flashes sit behind an analog switch on CS0 of bus 0, which
 * connects one of them to the QSPI controller. The safety processor drives
 * the select line, see board-scobc-v1-ps-sp-virt.dtsi. Without it, bank 0
 * is selected. Both banks hold the same part, SCOBC_BOOT_MEMORY.
 */
&pmc_qspi_0 {
    /* Not read by the QEMU model */
    /delete-property/ xlnx,qspi-mode;

    /delete-node/ qspi_flash_lcs_lb@0;
    /delete-node/ qspi_flash_lcs_ub@0;
    /delete-node/ qspi_flash_ucs_lb@0;
    /delete-node/ qspi_flash_ucs_ub@0;

    boot_mem_sel: boot_mem_sel@0 {
        compatible = "sc,qspi-mux";
        #address-cells = <1>;
        #size-cells = <0>;
        #bus-cells = <1>;
        reg = <0x0 0x0>;

        /* Bank 0 on CS0 of bus 0, bank 1 on CS1 of bus 1 */
        DI_SPI_FLASH(0, scobc_flash_bank0,
                     SCOBC_BOOT_MEMORY, 0x04000000, 0x0 0x0)

        DI_SPI_FLASH(1, scobc_flash_bank1,
                     SCOBC_BOOT_MEMORY, 0x04000000, 0x1 0x1)
    };
};

/* Disconnect all OSPI devices */
&ospi {
    /delete-node/ ospi_flash_lcs_lb@0;
    /delete-node/ ospi_flash_lcs_ub@0;
    /delete-node/ ospi_flash_ucs_lb@0;
    /delete-node/ ospi_flash_ucs_ub@0;
};

/*
 * eMMC mode is selected by attaching the drive at SD index 3, not by
 * properties. Drop the SD-card properties QEMU does not read.
 */
&sdhci1 {
    /delete-property/ is-mmc;
    /delete-property/ xlnx,has-cd;
    /delete-property/ xlnx,has-power;
    /delete-property/ xlnx,has-wp;
};

/* Delete second unused pysical ethernet node */
&{/mdio} {
    /delete-node/ phy@2;
};
